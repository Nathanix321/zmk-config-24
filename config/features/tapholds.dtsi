
#define ARCANE_REPEAT &arcane_repeat 0 0

#define HLT_NUM_SPACE  &hlt_mo_space_morph NUMBERS 0
#define HLT_NAV_ALPHA2 &hlt_mo_sl NAV ALPHA2

#define TH_SEMI_COLON &th_semi_colon_morph 0 0
#define TH_COMMA_Q    &th_comma_q_morph    0 0
#define TH_DOT_EXCL   &th_dot_excl_morph   0 0
#define TH_COLON_SEMI &th_colon_semi_morph 0 0
#define TH_Q_COMMA    &th_q_comma_morph    0 0
#define TH_EXCL_DOT   &th_excl_dot_morph   0 0

#define TH_LPAR &th_lpar 0 0
#define TH_RPAR &th_rpar 0 0

#define TH_LBKT &th_lbkt 0 0
#define TH_RBKT &th_rbkt 0 0

#define TH_LBRC &th_lbrc 0 0
#define TH_RBRC &th_rbrc 0 0

#define TH_APOS  &th_apos  0 0
#define TH_DQT   &th_dqt   0 0
#define TH_GRAVE &th_grave 0 0

#define TH_EQUAL &th_equal 0 0
#define TH_COLON &th_colon 0 0
#define TH_QMARK &th_qmark 0 0
#define TH_EXCL  &th_excl  0 0

#define TH_TAB   &th_tab   0 0
#define TH_ENTER &th_enter 0 0

#define TH_MIC_CAM &th_mic_cam 0 0

#define TH_BRC_IN &th_brc_in 0 0
#define TH_PARS_IN &th_pars_in 0 0
#define TH_BKTS_IN &th_bkts_in 0 0

#define TH_TWO_COLON &th_two_colon 0 0
#define TH_TWO_AMPS &th_two_amps 0 0
#define TH_TWO_PIPE &th_two_pipe 0 0

#define TH_END_PARS_SEMI &th_end_pars_semi 0 0
#define TH_END_SEMI &th_end_semi 0 0

#define TH_USD &th_usd 0 0
#define TH_CAD &th_cad 0 0

/ {
    definitions {
        // Main Keymap Tapholds
        TAPHOLD_TP_AGRESSIVE(arcane_repeat, &key_repeat, &arcane_key)

        TAPHOLD_TP(th_semi_colon_morph, &semi_colon_morph, &end_semi_colon_morph)
        TAPHOLD_TP(th_comma_q_morph,    &comma_q_morph,    &end_comma_q_morph)
        TAPHOLD_TP(th_dot_excl_morph,   &dot_excl_morph,   &end_dot_excl_morph)

        TAPHOLD_TP(th_colon_semi_morph, &colon_semi_morph, &end_colon_semi_morph)
        TAPHOLD_TP(th_q_comma_morph,    &q_comma_morph,    &end_q_comma_morph)
        TAPHOLD_TP(th_excl_dot_morph,   &excl_dot_morph,   &end_excl_dot_morph)

        TAPHOLD_TP(th_lpar, &mc_lpar, &mc_end_lpar)
        TAPHOLD_TP(th_rpar, &mc_rpar, &mc_end_rpar)

        TAPHOLD_TP(th_lbkt, &mc_lbkt, &mc_end_lbkt)
        TAPHOLD_TP(th_rbkt, &mc_rbkt, &mc_end_rbkt)

        TAPHOLD_TP(th_lbrc, &mc_lbrc, &mc_end_lbrc)
        TAPHOLD_TP(th_rbrc, &mc_rbrc, &mc_end_rbrc)

        TAPHOLD_TP(th_apos,  &mc_apos,  &mc_end_apos)
        TAPHOLD_TP(th_dqt,   &mc_dqt,   &mc_end_dqt)
        TAPHOLD_TP(th_grave, &mc_grave, &mc_end_grave)

        TAPHOLD_TP(th_equal, &mc_equal, &mc_end_equal)
        TAPHOLD_TP(th_colon, &mc_colon, &mc_end_colon)
        TAPHOLD_TP(th_qmark, &mc_qmark, &mc_end_qmark)
        TAPHOLD_TP(th_excl,  &mc_excl,  &mc_end_excl)

        TAPHOLD_TP(th_tab, &mc_tab, &mc_home_tab)
        TAPHOLD_TP(th_enter, &mc_enter, &mc_end_enter)

        TAPHOLD_TP(th_mic_cam, &mc_tog_mic_teams, &mc_tog_camera_teams)

        // Combo Tapholds
        TAPHOLD_TP(th_brc_in,  &mc_brc_in,  &mc_end_brc_in_n)
        TAPHOLD_TP(th_pars_in, &mc_pars_in, &mc_end_pars_in)
        TAPHOLD_TP(th_bkts_in, &mc_bkts_in, &mc_end_bkts_in)

        TAPHOLD_TP(th_two_colon, &mc_two_colon, &mc_end_two_colon)
        TAPHOLD_TP(th_two_amps,  &mc_two_amps,  &mc_end_two_amps)
        TAPHOLD_TP(th_two_pipe,  &mc_two_pipe,  &mc_end_two_pipe)

        TAPHOLD_TP(th_end_pars_semi, &mc_end_pars_semi, &mc_end_pars_semi_enter)
        TAPHOLD_TP(th_end_semi,      &mc_end_semi,      &mc_end_semi_enter)

        TAPHOLD_TP(th_usd, &mc_usd_sign, &mc_usd_letter)
        TAPHOLD_TP(th_cad, &mc_cad_sign, &mc_cad_letter)

        // Special Tapholds
        hlt_mo_sl: hlt_mo_sl {
            compatible = "zmk,behavior-hold-tap";
            #binding-cells = <2>;
            tapping-term-ms = <TAPPING_TERM>;
            flavor = "hold-preferred";
            quick-tap-ms = <QUICK_TAP_TERM>;
            bindings = <&mo>, <&sl>;
        };

        hlt_mo_space_morph: hlt_mo_space_morph {
            compatible = "zmk,behavior-hold-tap";
            #binding-cells = <2>;
            tapping-term-ms = <TAPPING_TERM>;
            flavor = "hold-preferred";
            quick-tap-ms = <QUICK_TAP_TERM>;
            bindings = <&mo>, <&space_under_morph>;
        };
    };
};
