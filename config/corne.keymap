#include <behaviors.dtsi>
#include <dt-bindings/zmk/keys.h>
#include <dt-bindings/zmk/bt.h>

#include <physical_layouts.dtsi>

/{ chosen { zmk,physical-layout = &foostan_corne_5col_layout; }; };

#include "keymap.dtsi"

